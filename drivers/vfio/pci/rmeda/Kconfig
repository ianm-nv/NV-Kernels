## drivers/vfio/pci/rmeda/Kconfig
```kconfig
# SPDX-License-Identifier: GPL-2.0-only

config RMEDA_VFIO
	tristate "RME DA VFIO Driver"
	depends on PCI && ARM64
	select VFIO_PCI_CORE
	select PCI_DOE
	select PCI_IDE
	select RMEDA_HOST
	help
	  Say Y or M here if you want to be able to assign a device
	  to a realm guest operating system.

	  When in doubt, say N.
```

## drivers/virt/rmeda/Kconfig
```kconfig
# SPDX-License-Identifier: GPL-2.0-only

config RMEDA_HOST
	tristate "RMEDA Host Library"
	depends on PCI && ARM64
	select PCI_DOE
	select PCI_IDE
	select CRYPTO_ECDSA
	select CRYPTO_RSA
	select X509_CERTIFICATE_PARSER

config RMEDA_GUEST
	tristate "RMEDA Guest Library"
	depends on PCI && ARM64
```
